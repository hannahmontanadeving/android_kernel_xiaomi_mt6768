## drivers/misc/hqsysfs/Kconfig
```kconfig
config TARGET_PRODUCT_LANCELOT
  bool "lancelot"
  default n

config TARGET_PRODUCT_MERLIN
  bool "merlin"
  default n

config HQ_SYSFS_SUPPORT
  bool "Enable Huaqin Sysfs Driver"
  default n
  help
    Huaqin Sysfs information driver includes specific information about hardware info and other info for HQ tools
```
